// Libraries

#include <WiFi.h> 
#include <PubSubClient.h> 
#include <SPI.h>
#include <Wire.h>
#include <Adafruit_GFX.h>
#include <Adafruit_SSD1306.h>

// Constant Definitions

#define SCREEN_WIDTH 128 // OLED display width, in pixels
#define SCREEN_HEIGHT 32 // OLED display height, in pixels
#define r 32             // Right LED
#define l 14             // Left LED

// Declaration for an SSD1306 display connected to I2C (SDA, SCL pins)
#define OLED_RESET    -1  // Reset pin # (or -1 if sharing Arduino reset pin)
#define LOGO_HEIGHT   32  // LOGO height, in pixels
#define LOGO_WIDTH    128 // LOGO width, in pixels

// WiFi Credentials
const char* ssid = "YOURSSID";
const char* password = "YOURPASSWORD";
// MQTT Credentials
const char* mqttServer = "192.168.xxx.xxx"; // MQTT IP ADDRESS
const int mqttPort = 1883; //Your port number

// Vars

char payload[512]; 

// Symbols

// White Screen
const unsigned char w [] PROGMEM = { 
  0xff, 0xff, 0xff, 0xff, 0xff, 0xff, 0xff, 0xff, 0xff, 0xff, 0xff, 0xff, 0xff, 0xff, 0xff, 0xff, 
  0xff, 0xff, 0xff, 0xff, 0xff, 0xff, 0xff, 0xff, 0xff, 0xff, 0xff, 0xff, 0xff, 0xff, 0xff, 0xff, 
  0xff, 0xff, 0xff, 0xff, 0xff, 0xff, 0xff, 0xff, 0xff, 0xff, 0xff, 0xff, 0xff, 0xff, 0xff, 0xff, 
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  0xff, 0xff, 0xff, 0xff, 0xff, 0xff, 0xff, 0xff, 0xff, 0xff, 0xff, 0xff, 0xff, 0xff, 0xff, 0xff
};

// Car Symbol
const unsigned char car [] PROGMEM = {
  0xff, 0xff, 0xff, 0xff, 0xff, 0xff, 0xff, 0xff, 0xff, 0xff, 0xff, 0xff, 0xff, 0xff, 0xff, 0xff, 
  0xff, 0xff, 0xff, 0xff, 0xff, 0xff, 0xff, 0xff, 0xff, 0xff, 0xff, 0xff, 0xff, 0xff, 0xff, 0xff, 
  0xff, 0xff, 0xff, 0xff, 0xff, 0xff, 0xff, 0xff, 0xff, 0xff, 0xff, 0xff, 0xff, 0xff, 0xff, 0xff, 
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  0xff, 0xff, 0xff, 0xff, 0xff, 0xff, 0xff, 0xff, 0xff, 0xff, 0xff, 0xff, 0xff, 0xff, 0xff, 0xff
};

// Dog Symbol
const unsigned char dog [] PROGMEM = {
  0xff, 0xff, 0xff, 0xff, 0xff, 0xff, 0xff, 0xff, 0xff, 0xff, 0xff, 0xff, 0xff, 0xff, 0xff, 0xff, 
  0xff, 0xff, 0xff, 0xff, 0xff, 0xff, 0xff, 0xff, 0xff, 0xfe, 0x3f, 0xff, 0xff, 0xff, 0xff, 0xff, 
  0xff, 0xff, 0xff, 0xff, 0xff, 0xff, 0xff, 0xff, 0xff, 0xfe, 0x33, 0xff, 0xff, 0xff, 0xff, 0xff, 
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  0xff, 0xff, 0xff, 0xff, 0xff, 0xff, 0xff, 0xff, 0xff, 0xff, 0xff, 0xff, 0xff, 0xff, 0xff, 0xff
};

// Motorcycle Symbol
const unsigned char moto [] PROGMEM = {
  0xff, 0xff, 0xff, 0xff, 0xff, 0xff, 0xff, 0xff, 0xff, 0xff, 0xff, 0xff, 0xff, 0xff, 0xff, 0xff, 
  0xff, 0xff, 0xff, 0xff, 0xff, 0xff, 0xff, 0xff, 0xff, 0xff, 0xff, 0x03, 0xff, 0xff, 0xff, 0xff, 
  0xff, 0xff, 0xff, 0xff, 0xff, 0xff, 0xff, 0xff, 0xff, 0xff, 0xff, 0x03, 0xff, 0xff, 0xff, 0xff, 
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  0xff, 0xff, 0xff, 0xff, 0xff, 0xff, 0xff, 0xff, 0xff, 0xff, 0xff, 0xff, 0xff, 0xff, 0xff, 0xff
};

// People Symbol
const unsigned char peo [] PROGMEM = {
  0xff, 0xff, 0xff, 0xff, 0xff, 0xff, 0xff, 0xff, 0xff, 0xff, 0xff, 0xff, 0xff, 0xff, 0xff, 0xff, 
  0xff, 0xff, 0xff, 0xff, 0xff, 0xff, 0xff, 0xff, 0xff, 0xff, 0xff, 0xff, 0xff, 0xff, 0xff, 0xff, 
  0xff, 0xff, 0xf8, 0x00, 0x3f, 0xff, 0xff, 0xff, 0xff, 0xff, 0xff, 0xfc, 0x00, 0x1f, 0xff, 0xff, 
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  0xff, 0xff, 0xff, 0xff, 0xff, 0xff, 0xff, 0xff, 0xff, 0xff, 0xff, 0xff, 0xff, 0xff, 0xff, 0xff
};


// Module Declaration

WiFiClient ESPClient;
PubSubClient client(ESPClient);
Adafruit_SSD1306 display(SCREEN_WIDTH, SCREEN_HEIGHT, &Wire, OLED_RESET);

// MQTT Callback

void callback(char* topic, byte* payload, unsigned int length) {
  Serial.print("Message arrived [");
  Serial.print(topic);
  Serial.print("] ");
  String inVal="";

// Save the payload in variable
  for (int i=0;i<length;i++) {
    inVal.concat((char)payload[i]);
  }


// Show symbols depends on payload
  if (inVal == "m0") {
    testdrawbitmap(moto);
  digitalWrite(r,HIGH);
  digitalWrite(l,LOW);
  } 
  else if (inVal == "m1") {
    testdrawbitmap(moto);
              digitalWrite(r,LOW);
  digitalWrite(l,HIGH);
  } 
  else if (inVal == "c0") {
      digitalWrite(r,HIGH);
  digitalWrite(l,LOW);
    testdrawbitmap(car);
  } 
  else if (inVal == "c1") {
    testdrawbitmap(car);
              digitalWrite(r,LOW);
  digitalWrite(l,HIGH);
  } 
  else if (inVal == "p0") {
      digitalWrite(r,HIGH);
  digitalWrite(l,LOW);
    testdrawbitmap(peo);
  } 
  else if (inVal == "p1") {
    testdrawbitmap(peo);
              digitalWrite(r,LOW);
  digitalWrite(l,HIGH);
  } 
    else if (inVal == "d0") {
        digitalWrite(r,HIGH);
  digitalWrite(l,LOW);
    testdrawbitmap(dog);
  } 
    else if (inVal == "d1") {
    testdrawbitmap(dog);
          digitalWrite(r,LOW);
  digitalWrite(l,HIGH);
  } 
  else
  {
    testdrawbitmap(w);
              digitalWrite(r,LOW);
  digitalWrite(l,LOW);
  }
  Serial.println(inVal);
  
}

// Reconnect algorithm

void reconnect() {
  // Loop until we're reconnected
  Serial.println("ESP > Connected to WiFi");
  client.setServer(mqttServer, mqttPort);
  client.setCallback(callback);
 
  while (!client.connected()) {
    Serial.println("ESP > Connecting to MQTT...");
 
    if (client.connect("ESP32Client")) {
 
      Serial.println("connected to CloudMQTT");
 
    } else {
 
      Serial.print("ERROR > failed with state ");
      Serial.print(client.state());
      delay(2000);
 
    }
  }  
  client.publish("ESP32", "Reconnect OK");
  client.subscribe("inTopic");
}

char* string2char(String command){
    if(command.length()!=0){
        char *p = const_cast<char*>(command.c_str());
        return p;
    }
}
 
void setup() {
  // Setup Leds
  pinMode(r,OUTPUT);
  pinMode(l,OUTPUT);
  digitalWrite(r,LOW);
  digitalWrite(l,LOW);
  
  Serial.begin(9600);
    if(!display.begin(SSD1306_SWITCHCAPVCC, 0x3C)) { // Address 0x3C for 128x32
    Serial.println(F("SSD1306 allocation failed"));
    for(;;); // Don't proceed, loop forever
  }

  // SSD1306_SWITCHCAPVCC = generate display voltage from 3.3V internally

  testdrawbitmap(w);

  // Show initial display buffer contents on the screen --
  display.display();
  

// Wifi Start

  WiFi.begin(ssid, password);
 
  while (WiFi.status() != WL_CONNECTED) {
    delay(500);
    Serial.println("Please wait while connecting to WiFi");
  }
 
  Serial.println("ESP > Connected to WiFi");
  client.setServer(mqttServer, mqttPort);
  client.setCallback(callback);
 
  while (!client.connected()) {
    Serial.println("ESP > Connecting to MQTT...");
 
    if (client.connect("ESP32Client")) {
 
      Serial.println("connected to MQTT");
 
    } else {
 
      Serial.print("ERROR > failed with state ");
      Serial.print(client.state());
      delay(2000);
 
    }
  }  
  client.publish("ESP32", "Start OK");
  client.subscribe("inTopic");
  
}

// Client Loop

void loop() { 
  if (!client.connected()) {
    reconnect();
  }
  client.loop();
}


// Display in Screen
void testdrawbitmap(const unsigned char draw[]) {
  display.clearDisplay();

  display.drawBitmap(
    (display.width()  - LOGO_WIDTH ) / 2,
    (display.height() - LOGO_HEIGHT) / 2,
    draw, LOGO_WIDTH, LOGO_HEIGHT, 1);
  display.display();
}
